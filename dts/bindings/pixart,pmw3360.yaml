## dts/bindings/pixart,pmw3360.yaml
```yaml
description: |
    This is a representation of the PMW3360 optical motion sensor

compatible: "pixart,pmw3360"

include: spi-device.yaml

properties:
    irq-gpios:
      type: phandle-array
      required: true
    scroll-layers:
      type: array
      default: []
    snipe-layers:
      type: array
      default: []
    automouse-layer:
      type: int
      default: -1
    cpi:
      type: int
      default: 600
      description: "CPI value (Range: 200 - 3200, Step: 200)"
    evt-type:
      type: int
      required: true
    x-input-code:
      type: int
      required: true
    y-input-code:
      type: int
      required: true
    force-awake:
      type: boolean
```

## dts/bindings/pixart,pmw3366.yaml
```yaml
description: |
    This is a representation of the PMW3366 optical motion sensor

compatible: "pixart,pmw3366"

include: spi-device.yaml

properties:
    irq-gpios:
        type: phandle-array
        required: true
```
